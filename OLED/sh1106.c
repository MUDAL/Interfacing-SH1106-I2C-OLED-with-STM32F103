#include "stm32f10x.h"                  // Device header
#include "SH1106.h"
#include "systick.h"
#include "i2c.h"
#include <string.h>

#define SH1106_I2C_ADDR   0x3C
#define FONT_WIDTH				7
#define FONT_HEIGHT				10

static uint16_t xPos; 
static uint16_t yPos; 
static uint8_t screenBuffer[SH1106_BUFFER_SIZE];

const uint16_t Font_7x10 [] = 
{
0x0000, 0x0000, 0x0000, 0x0000, 0x0000, 0x0000, 0x0000, 0x0000, 0x0000, 0x0000,  // sp
0x1000, 0x1000, 0x1000, 0x1000, 0x1000, 0x1000, 0x0000, 0x1000, 0x0000, 0x0000,  // !
0x2800, 0x2800, 0x2800, 0x0000, 0x0000, 0x0000, 0x0000, 0x0000, 0x0000, 0x0000,  // "
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0x0000, 0x0000, 0x0000, 0x7400, 0x4C00, 0x0000, 0x0000, 0x0000, 0x0000, 0x0000,  // ~
};

// Send a byte to the command register
static void SH1106_WriteCommand(uint8_t byte) 
{
	I2C_WriteByte(I2C1,SH1106_I2C_ADDR,0x00,byte);
}

// Send data
static void SH1106_WriteData(uint8_t* buffer, uint32_t buff_size) 
{
	I2C_WriteMultiByte(I2C1,SH1106_I2C_ADDR,0x40,buffer,buff_size);
}

// Fill the whole screen with the given color
static void SH1106_Fill(SH1106_COLOR color) 
{
	for(uint32_t i = 0; i < sizeof(screenBuffer); i++) 
	{
			screenBuffer[i] = (color == Black) ? 0x00 : 0xFF;
	}
}

// Initialize the oled screen
void SH1106_Init(void) 
{
	SysTick_DelayMs(100); // Wait for the screen to boot
	SH1106_WriteCommand(0xAE);   // Display off
	SH1106_WriteCommand(0x20);   // Set Memory Addressing Mode
	SH1106_WriteCommand(0x10);   // 00,Horizontal Addressing Mode;01,Vertical Addressing Mode;10,Page Addressing Mode (RESET);11,Invalid
	SH1106_WriteCommand(0xB0);   // Set Page Start Address for Page Addressing Mode,0-7
	SH1106_WriteCommand(0xC8);   // Set COM Output Scan Direction
	SH1106_WriteCommand(0x00);   // Set low column address
	SH1106_WriteCommand(0x10);   // Set high column address
	SH1106_WriteCommand(0x40);   // Set start line address
	SH1106_WriteCommand(0x81);   // set contrast control register
	SH1106_WriteCommand(0xFF);
	SH1106_WriteCommand(0xA1);   // Set segment re-map 0 to 127
	SH1106_WriteCommand(0xA6);   // Set normal display
	SH1106_WriteCommand(0xA8);   // Set multiplex ratio(1 to 64)
	SH1106_WriteCommand(0x3F);
	SH1106_WriteCommand(0xA4);   // 0xa4,Output follows RAM content;0xa5,Output ignores RAM content
	SH1106_WriteCommand(0xD3);   // Set display offset
	SH1106_WriteCommand(0x00);   // No offset
	SH1106_WriteCommand(0xD5);   // Set display clock divide ratio/oscillator frequency
	SH1106_WriteCommand(0xF0);   // Set divide ratio
	SH1106_WriteCommand(0xD9);   // Set pre-charge period
	SH1106_WriteCommand(0x22);
	SH1106_WriteCommand(0xDA);   // Set com pins hardware configuration
	SH1106_WriteCommand(0x12);
	SH1106_WriteCommand(0xDB);   // Set vcomh
	SH1106_WriteCommand(0x20);   // 0x20,0.77xVcc
	SH1106_WriteCommand(0x8D);   // Set DC-DC enable
	SH1106_WriteCommand(0x14);   //
	SH1106_WriteCommand(0xAF);   // Turn on SH1106 panel
	SH1106_Fill(Black); // Clear screen
	SH1106_UpdateScreen(); // Flush buffer to screen
	// Set default values for screen object
	xPos = 0;
	yPos = 0;
}

// Write the screenbuffer with changed to the screen
void SH1106_UpdateScreen(void) 
{
	// Write data to each page of RAM. Number of pages
	// depends on the screen height:
	//
	//  * 32px   ==  4 pages
	//  * 64px   ==  8 pages
	//  * 128px  ==  16 pages
	for(uint8_t i = 0; i < SH1106_HEIGHT/8; i++) 
	{
		SH1106_WriteCommand(0xB0 + i); // Set the current RAM page address.
		SH1106_WriteCommand(0x00);
		SH1106_WriteCommand(0x10);
		SH1106_WriteData(&screenBuffer[SH1106_WIDTH*i],SH1106_WIDTH);
	}
}

void SH1106_DrawPixel(uint8_t x, uint8_t y, SH1106_COLOR color) 
{
	if(x >= SH1106_WIDTH || y >= SH1106_HEIGHT) 
	{
		return; // Don't write outside the buffer
	}
	// Draw in the right color
	if(color == White) 
	{
		screenBuffer[x + (y / 8) * SH1106_WIDTH] |= 1 << (y % 8);
	} 
	else 
	{
		screenBuffer[x + (y / 8) * SH1106_WIDTH] &= ~(1 << (y % 8));
	}
}

char SH1106_WriteChar(char ch, SH1106_COLOR color) 
{
	uint32_t i, b, j;
	// Check if character is valid
	if(ch < 32 || ch > 126)
	{
		return 0;
	}
	// Check remaining space on current line
	if(SH1106_WIDTH < (xPos + FONT_WIDTH) ||
		 SH1106_HEIGHT < (yPos + FONT_HEIGHT))
	{
		return 0; // Not enough space on current line
	}
	// Use the font to write
	for(i = 0; i < FONT_HEIGHT; i++) 
	{
		b = Font_7x10[(ch - 32) * FONT_HEIGHT + i];
		for(j = 0; j < FONT_WIDTH; j++) 
		{
			if((b << j) & 0x8000)  
			{
				SH1106_DrawPixel(xPos + j, (yPos + i), (SH1106_COLOR) color);
			} 
			else 
			{
				SH1106_DrawPixel(xPos + j, (yPos + i), (SH1106_COLOR)!color);
			}
		}
	}
	xPos += FONT_WIDTH; // The current space is now taken
	return ch; // Return written char for validation
}

// Write full string to screenbuffer
char SH1106_WriteString(char* str, SH1106_COLOR color) 
{
	// Write until null-byte
	while(*str) 
	{
		if(SH1106_WriteChar(*str, color) != *str) 
		{
			return *str; // Char could not be written
		}
		str++; // Next char
	}
	return *str; // Everything ok
}

void SH1106_SetCursor(uint8_t x, uint8_t y) 
{
	xPos = x;
	yPos = y;
}

void SH1106_ClearScreen(void)
{
	memset(screenBuffer,0,SH1106_BUFFER_SIZE);
}
